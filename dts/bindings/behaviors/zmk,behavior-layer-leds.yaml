## dts/bindings/behaviors/zmk,behavior-layer-leds.yaml
```yaml
description: Synchronize the active Piantor layer's LED color between halves.
compatible: "zmk,behavior-layer-leds"
include: one_param.yaml

properties:
  layer-colors:
    type: array
    description: Packed RGB colors by layer ID. Zero leaves the LEDs off.
```

## zephyr/Kconfig
```kconfig
config PIANTOR_STATUS_LEDS
    bool "Piantor Pro BT layer and battery LEDs"
    depends on (BOARD_PIANTOR_PRO_BT_LEFT || BOARD_PIANTOR_PRO_BT_RIGHT) && ZMK_SPLIT_BLE
    depends on !ZMK_RGB_UNDERGLOW
    default y
    select ZMK_BATTERY_REPORTING
    select LED_STRIP
    select WS2812_STRIP
```
