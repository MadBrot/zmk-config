#include <behaviors.dtsi>
#include <dt-bindings/zmk/keys.h>
#include <dt-bindings/zmk/bt.h>
#include <dt-bindings/zmk/rgb.h>
#include <zmk-helpers/helper.h>

/* Left */
#define LT4  1
#define LT3  2
#define LT2  3
#define LT1  4
#define LT0  5

#define LM4 13
#define LM3 14
#define LM2 15
#define LM1 16
#define LM0 17

#define LB4 25
#define LB3 26
#define LB2 27
#define LB1 28
#define LB0 29

#define LH2 36
#define LH1 37
#define LH0 38

/* Right */
#define RT0  6
#define RT1  7
#define RT2  8
#define RT3  9
#define RT4 10

#define RM0 18
#define RM1 19
#define RM2 20
#define RM3 21
#define RM4 22

#define RB0 30
#define RB1 31
#define RB2 32
#define RB3 33
#define RB4 34

#define RH0 39
#define RH1 40
#define RH2 41

#define KEYS_L LT4 LT3 LT2 LT1 LT0 LM4 LM3 LM2 LM1 LM0 LB4 LB3 LB2 LB1 LB0
#define KEYS_R RT0 RT1 RT2 RT3 RT4 RM0 RM1 RM2 RM3 RM4 RB0 RB1 RB2 RB3 RB4
#define THUMBS LH2 LH1 LH0 RH0 RH1 RH2

// Layers
#define BASE  0
#define LOWER 1
#define MOUSE 4
#define OMNI  5

// Keys
#define MEH LG(LC(LS(LALT)))
#define ___ &trans
#define _0_ &to BASE 

#define QUICK_TAP_MS 175

#include "includes/mouse.dtsi"

#define MAKE_HRM(NAME, HOLD, TAP, TRIGGER_POS)                                 \
  ZMK_HOLD_TAP(NAME, bindings = <HOLD>, <TAP>; flavor = "balanced";            \
               tapping-term-ms = <280>; quick-tap-ms = <QUICK_TAP_MS>;         \
               require-prior-idle-ms = <150>; hold-trigger-on-release;         \
               hold-trigger-key-positions = <TRIGGER_POS>;)

MAKE_HRM(hml, &kp, &kp, KEYS_R THUMBS)
MAKE_HRM(hmr, &kp, &kp, KEYS_L THUMBS)

/* German umlauts via macOS Option dead keys (ABC/US) */
ZMK_MACRO(ae_l, wait-ms = <30>; tap-ms = <30>; bindings = <&macro_tap &kp LA(U) &kp A>;)
ZMK_MACRO(ae_u, wait-ms = <30>; tap-ms = <30>; bindings = <&macro_tap &kp LA(U) &kp LS(A)>;)
ZMK_MACRO(oe_l, wait-ms = <30>; tap-ms = <30>; bindings = <&macro_tap &kp LA(U) &kp O>;)
ZMK_MACRO(oe_u, wait-ms = <30>; tap-ms = <30>; bindings = <&macro_tap &kp LA(U) &kp LS(O)>;)
ZMK_MACRO(ue_l, wait-ms = <30>; tap-ms = <30>; bindings = <&macro_tap &kp LA(U) &kp U>;)
ZMK_MACRO(ue_u, wait-ms = <30>; tap-ms = <30>; bindings = <&macro_tap &kp LA(U) &kp LS(U)>;)
ZMK_MACRO(sz, wait-ms = <30>; tap-ms = <30>; bindings = <&macro_tap &kp LA(S)>;)

ZMK_MOD_MORPH(_ae, bindings = <&ae_l>, <&ae_u>; mods = <(MOD_LSFT|MOD_RSFT)>;)
ZMK_MOD_MORPH(_oe, bindings = <&oe_l>, <&oe_u>; mods = <(MOD_LSFT|MOD_RSFT)>;)
ZMK_MOD_MORPH(_ue, bindings = <&ue_l>, <&ue_u>; mods = <(MOD_LSFT|MOD_RSFT)>;)

/* RAISE programming arrows */
ZMK_MACRO(arr, bindings = <&macro_tap &kp MINUS &kp GT>;)
ZMK_MACRO(fat, bindings = <&macro_tap &kp EQUAL &kp GT>;)

/ {
    chosen { zmk,physical-layout = &default_layout; };
};

/ {
    combos {
        compatible = "zmk,combos";

        gaming {
            bindings = <&to 3>;
            key-positions = <0 24 11 35>;
        };

        enter {
            bindings = <&kp ENTER>;
            key-positions = <19 20 21>;
        };

        combo_backspace_left {
            bindings = <&kp BSPC>;
            key-positions = <LB3 LB2 LB1>;
        };

        combo_backspace_right {
            bindings = <&kp BSPC>;
            key-positions = <RB3 RB2 RB1>;
        };

        delete {
            bindings = <&kp DEL>;
            key-positions = <LM3 LM2 LM1>;
        };

        sleep {
            bindings = <&kp K_SLEEP>;
            key-positions = <0 12 24>;
        };

        combo_caps_word {
            timeout-ms = <50>;
            key-positions = <LM1 RM1>;
            bindings = <&caps_word>;
            layers = <BASE>;
        };

        combo_mouse {
            timeout-ms = <50>;
            key-positions = <RH1 RH2>;
            bindings = <&to MOUSE>;
            layers = <BASE>;
        };

        // combo_reset {
        //     timeout-ms = <50>;
        //     key-positions = <LT0 RT0>;
        //     bindings = <&sys_reset>;
        //     layers = <BASE>;
        // };

        // combo_boot {
        //     timeout-ms = <50>;
        //     key-positions = <LB0 RB0>;
        //     bindings = <&bootloader>;
        //     layers = <BASE>;
        // };

        // combo_dot_spc {
        //     timeout-ms = <50>;
        //     key-positions = <LH0 RH0>;
        //     bindings = <&dot_spc>;
        //     layers = <BASE>;
        // };

        // -
        combo_minus {
            timeout-ms = <50>;
            key-positions = <RB0 RB1>;
            bindings = <&kp MINUS>;
            layers = <BASE>;
        };

        // _
        combo_underscore {
            timeout-ms = <50>;
            key-positions = <LB0 RB0>;
            bindings = <&kp UNDER>;
            layers = <BASE>;
        };

        // =
        combo_equal {
            timeout-ms = <50>;
            key-positions = <RM0 RM1>;
            bindings = <&kp EQUAL>;
            layers = <BASE>;
        };

        // `
        combo_grave {
            timeout-ms = <50>;
            key-positions = <LT3 LT2>;
            bindings = <&kp GRAVE>;
            layers = <BASE>;
        };

        // |
        combo_pipe {
            timeout-ms = <50>;
            key-positions = <RB3 RB4>;
            bindings = <&kp PIPE>;
            layers = <BASE>;
        };

        // [
        combo_lbkt {
            timeout-ms = <50>;
            key-positions = <RT1 RM1>;
            bindings = <&kp LBKT>;
            layers = <BASE>;
        };

        // ]
        combo_rbkt {
            timeout-ms = <50>;
            key-positions = <RT3 RM3>;
            bindings = <&kp RBKT>;
            layers = <BASE>;
        };

        // {
        combo_lbrc {
            timeout-ms = <50>;
            key-positions = <RT1 RT2>;
            bindings = <&kp LBRC>;
            layers = <BASE>;
        };

        // }
        combo_rbrc {
            timeout-ms = <50>;
            key-positions = <RT2 RT3>;
            bindings = <&kp RBRC>;
            layers = <BASE>;
        };

        // (
        combo_lpar {
            timeout-ms = <50>;
            key-positions = <RM1 RM2>;
            bindings = <&kp LPAR>;
            layers = <BASE>;
        };

        // )
        combo_rpar {
            timeout-ms = <50>;
            key-positions = <RM2 RM3>;
            bindings = <&kp RPAR>;
            layers = <BASE>;
        };

        // <
        combo_lt {
            timeout-ms = <50>;
            key-positions = <RB1 RB2>;
            bindings = <&kp LT>;
            layers = <BASE>;
        };

        // >
        combo_gt {
            timeout-ms = <50>;
            key-positions = <RB2 RB3>;
            bindings = <&kp GT>;
            layers = <BASE>;
        };

        combo_select_all {
            timeout-ms = <50>;
            key-positions = <LT4 LM4>;
            bindings = <&kp LG(A)>;
            layers = <BASE>;
        };

        combo_undo {
            timeout-ms = <50>;
            key-positions = <LM4 LB4>;
            bindings = <&kp LG(Z)>;
            layers = <BASE>;
        };

        combo_cut {
            timeout-ms = <50>;
            key-positions = <LM3 LB3>;
            bindings = <&kp LG(X)>;
            layers = <BASE>;
        };

        combo_copy {
            timeout-ms = <50>;
            key-positions = <LM2 LB2>;
            bindings = <&kp LG(C)>;
            layers = <BASE>;
        };

        combo_paste {
            timeout-ms = <50>;
            key-positions = <LM1 LB1>;
            bindings = <&kp LG(V)>;
            layers = <BASE>;
        };
    };

    keymap {
        compatible = "zmk,keymap";

        default_layer {
            display-name = "QWERTY";
            bindings = <
                &kp TAB     &kp Q            &kp W            &kp E                &kp R              &kp T         &kp Y        &kp U               &kp I                 &kp O             &kp P                    &kp BSPC
                &kp ESCAPE  &kp A            &hml LALT S        &hml LGUI D          &hml LCTRL F          &hml MEH G    &hmr MEH H   &hmr RCTRL J           &hmr RGUI K           &hmr RALT L         &kp SEMICOLON            &kp SQT
                &kp LSHFT   &kp Z            &kp X            &kp C                &kp V              &kp B         &kp N        &kp M               &kp COMMA             &kp DOT           &kp FSLH                 &to MOUSE
                                                              &kp LALT        &kp LEFT_SHIFT     &mo 1         &mo 2        &kp SPACE  &mo OMNI
            >;
        };

        lower_layer {
            display-name = "LOWER";
            bindings = <
                &kp TAB    &bt BT_SEL 0  &bt BT_SEL 1  &bt BT_SEL 2  &bt BT_SEL 3  &bt BT_SEL 4  &bt BT_CLR  &rgb_ug RGB_TOG  &sys_reset  &studio_unlock  &trans  &trans
                &kp LCTRL  &trans        &trans        &trans        &trans        &trans        &kp LEFT   &kp DOWN        &kp UP      &kp RIGHT       &kp HOME &kp END
                &kp LSHFT  &trans        &trans        &trans        &trans        &trans        &kp LA(LEFT) &kp PG_DN     &kp PG_UP   &kp LA(RIGHT)   &trans  &trans
                                       &kp LGUI        &trans      &trans         &trans        &kp BSPC  &trans
            >;
        };

        raise_layer {
            display-name = "SYMBOL";
            bindings = <
                &kp TAB    &kp N1           &kp AMPERSAND     &kp ASTERISK        &kp MINUS              &kp CARET   &trans   &kp N7  &kp N8  &kp N9  &arr     &kp BSPC
                &kp LCTRL  &_ae             &sz               &_oe                &_ue                   &kp EQUAL   &trans   &kp N4  &kp N5  &kp N6  &kp BSLH &kp GRAVE
                &kp LSHFT  &kp EXCLAMATION  &kp AT_SIGN       &kp POUND            &kp DOLLAR             &kp PERCENT &kp N0   &kp N1  &kp N2  &kp N3  &fat     &trans
                                            &trans         &trans              &trans                                 &trans   &kp N0  &kp N0
            >;
        };

        gaming {
            bindings = <
                &kp ESCAPE  &kp TAB          &kp Q  &kp W  &kp E  &kp R   &none  &none  &none  &none  &none  &to 0
                &none       &kp LEFT_SHIFT   &kp A  &kp S  &kp D  &kp F   &none  &none  &none  &none  &none  &none
                &none       &kp LEFT_CONTROL &kp Z  &kp X  &kp C  &kp V   &none  &none  &none  &none  &none  &none
                                             &none  &kp SPACE  &kp LEFT_ALT  &none  &none  &none
            >;
        };

        mouse {
            bindings = <
                _0_      _0_      _0_      _0_       _0_       _0_      _MS_L   _MS_D   _MS_U   _MS_R   _0_      _0_
                _0_      &kp RGUI &kp LALT &kp LCTRL &kp LSHFT _0_     _MM_L   _MM_D   _MM_U   _MM_R   _0_      _0_
                _0_      _0_      _0_      _0_       _0_       _0_      _0_     &kp PG_DN &kp PG_UP _0_      _0_      _0_
                                  _0_      _0_       _0_      &mkp LCLK &mkp RCLK &mkp MCLK
            >;
        };

        /* Right cols 2–4, same order as the symbol numpad */
        omni_layer {
            display-name = "OMNI";
            bindings = <
                &trans  &trans  &trans  &trans  &trans  &trans    &trans  &kp LA(N7)  &kp LA(N8)  &kp LA(N9)  &trans  &trans
                &trans  &trans  &trans  &trans  &trans  &trans    &trans  &kp LA(N4)  &kp LA(N5)  &kp LA(N6)  &trans  &trans
                &trans  &trans  &trans  &trans  &trans  &trans    &trans  &kp LA(N1)  &kp LA(N2)  &kp LA(N3)  &trans  &trans
                                        &trans  &trans  &trans    &trans  &trans      &trans
            >;
        };
    };
};
